#include "display/Display.h"

namespace Display {

#define LED_WIDTH          40
#define FRAMES_PER_SECOND  15
#define MAX_CHAR_WIDTH      6
#define LED_HEIGHT          8

#define LED_TYPE    WS2812B
#define COLOR_ORDER GRB

#define BRIGHTNESS 32

static const CRGB RAIN_DROP = CRGB(175,255,175);
static const CRGB RAIN_TAIL = CRGB(27,130,39);

static const uint8_t char_data[6][472] = {
{ 1, 0, 1, 0, 1, 0, 0, 0, 0, 0, 0, 0, 0,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 0, 0 },
{ 1, 0, 1, 0, 1, 0, 0, 1, 0, 1, 0, 0, 0,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 0, 0 },
{ 1, 0, 0, 0, 0, 0, 1, 1, 1, 1, 1, 0, 1,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 0, 1 },
{ 1, 0, 0, 0, 0, 0, 0, 1, 0, 1, 0, 0, 0,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 1, 0 },
{ 0, 0, 0, 0, 0, 0, 1, 1, 1, 1, 1, 0, 0,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 0, 0 },
{ 1, 0, 0, 0, 0, 0, 0, 1, 0, 1, 0, 0, 0,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 0, 0 }
};

static const uint ofs[] = {0,2,6,12,18,24,30,32,35,38,44,50,53,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467,472};

static const CRGB firePalette[] = {
  CRGB(7,7,7),
  CRGB(35,10,7),
  CRGB(103,20,7),
  CRGB(175,63,7),
  CRGB(223,87,7),
  CRGB(207,127,15),
  CRGB(191,167,39),
  CRGB(0xEF,0xEF,0xC7)
};

static const int firePaletteLen = sizeof(firePalette)/sizeof(firePalette[0]);

static uint8_t firePixels[LED_HEIGHT][LED_WIDTH];

static CRGB leds[LED_WIDTH * LED_HEIGHT];

void setup() {
  FastLED.addLeds<LED_TYPE, GPIO_NUM_23, COLOR_ORDER>(leds, LED_WIDTH * LED_HEIGHT).setCorrection(TypicalLEDStrip).setDither(1);
  FastLED.setBrightness(BRIGHTNESS);
}

int width() {
  return LED_WIDTH;
}

int maxCharWidth() {
  return MAX_CHAR_WIDTH;
}

int framesPerSecond() {
  return FRAMES_PER_SECOND;
}

uint rcToDispIdx(const uint row, const uint col) {
  // this display is wired in zig zag pattern 
  // with led index 0 in bottom left
  //  7   8  23  24 ..
  //  6   9  22  25 ..
  //  .  ..  ..  .. ..
  //  .  ..  ..  .. ..
  //  1  14  17  30 ..
  //  0  15  16  31 ..
  //
  // (row,col) for api assumes (0,0) in top left of display
  // so need to map like below etc
  // (0,0) = 7
  // (1,0) = 6
  // (6,0) = 1
  // (7,0) = 0
  //
  // (0,1) = 8
  // (1,1) = 9
  // (6,1) = 14
  // (7,1) = 15
  return ((col & 1) == 0) 
    ? col * LED_HEIGHT + row
    : ((col + 1) * LED_HEIGHT) - 1 - row;
}

int writeChar(int col, CRGB color, char c) {
  if (c == ' ') {
    return 3;
  }
  uint charDefOfs = ofs[c - '!'];
  uint charDefSize = ofs[c - '!' + 1] - charDefOfs;
  for (uint8_t row = 0; row < 6; row++) {
    for (uint charCol = 0; charCol < charDefSize; charCol++) {
      int ledCol = charCol + col;
      if (ledCol >= 0 && ledCol < LED_WIDTH) {
        if (char_data[row][charCol + charDefOfs]) {
          uint ledIdx = rcToDispIdx(row + 1, ledCol);
          leds[ledIdx] = color;
        }
      }
    }
  }
  return charDefSize;
}

int writeString(int col, CRGB color, char* msg) {
  char* msgChar = msg;
  int charStart = col;
  while(*msgChar) {
    int charSize = writeChar(charStart, color, *msgChar);
    charStart += charSize;
    msgChar++;
  }
  return charStart;
}

int writeString(int col, CRGB color, const String& msg) {
  int charStart = col;
  for (const char* c = msg.begin(); c != msg.end(); c++) {
    int charSize = writeChar(charStart, color, *c);
    charStart += charSize;
  }
  return charStart;
}

void sanitize(String& msg) {
  unsigned int i = 0;
  while (i < msg.length()) {
    if (msg[i] >= ' ' && msg[i] <= '~') {
      i++;
    } else {
      msg.remove(i, 1);
    }
  }
}

void stepSparkle() {
  int maxled = LED_WIDTH * LED_HEIGHT;
  CRGB white = CRGB(255,255,255);
  for (int idx = 0; idx < maxled; idx++) {
    if (leds[idx].getLuma() == 0 && random8(255) > 250) {
      leds[idx] = white;
    } else if (leds[idx] == white && random8(255) > 200) {
      leds[idx] = CHSV(random8(255), random8(255), 255);
    } else {
      leds[idx].nscale8(192);
    }
  }
}

void stepDigitalRain() {
  for (int row=LED_HEIGHT - 1; row>=0; row--)
  {
    for (int col=0; col<LED_WIDTH; col++)
    {
      uint ledIdx = rcToDispIdx(row, col);
      if (leds[ledIdx] == RAIN_DROP)
      {
        leds[ledIdx] = RAIN_TAIL;
        if (row < LED_HEIGHT - 1) {
          uint nextHead = rcToDispIdx(row + 1, col);
          leds[nextHead] = RAIN_DROP; 
        }
      }
      if (leds[ledIdx].g != 255) {
        leds[ledIdx].nscale8(192);
      }
    }
  }

  for (int col=0; col<LED_WIDTH; col++) {
    bool noCode = true;
    for (int row=0; row<LED_HEIGHT; row++) {
      uint ledIdx = rcToDispIdx(row, col);
      if (leds[ledIdx] == RAIN_DROP) {
        noCode = false;
        break;
      }
    }
    if (noCode && random(24) == 0) {
      uint ledIdx = rcToDispIdx(0, col);
      leds[ledIdx] = RAIN_DROP;
    }
  }
}

void fireDebugPrint() {
  char dgbstr[3*LED_WIDTH + 1];
  for (uint row = 0; row < LED_HEIGHT; row++) {
    uint len = 0;
    for (uint col = 0; col < LED_WIDTH; col++) {
      len += sprintf(dgbstr + len, "%2d ", firePixels[row][col]);
    }
    Serial.println(dgbstr);
  }
  Serial.println();
}

void spreadFire(uint row, uint col) {
  int rand = random8(0, 4);
  int belowCol = col - rand + 1;
  belowCol = (LED_WIDTH + belowCol) & LED_WIDTH;
  int belowColor = firePixels[row + 1][col];
  rand = random8(0, 3);
  int newColor = belowColor - 1;
  firePixels[row][col] = (newColor < 0) ? 0 : newColor;
}

void setFlame(uint row, uint col) {
  int rand = random8(0, 6);
  firePixels[row][col] = 7 - rand;
}

void stepFire() {
  //fireDebugPrint();
  for (uint col=0; col < LED_WIDTH; col++) {
    for (uint row=0; row < LED_HEIGHT - 1; row++) {
      spreadFire(row, col);
    }
  }
  for (uint col=0; col < LED_WIDTH; col++) {
    setFlame(LED_HEIGHT - 1, col);
  }
  for (uint col=0; col < LED_WIDTH; col++) {
    for (uint row=0; row < LED_HEIGHT; row++) {
      leds[rcToDispIdx(row, col)] = firePalette[firePixels[row][col]];
    }
  }
}

void clear() {
  FastLED.clear();
}

}