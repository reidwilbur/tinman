#include <Arduino.h>
#include "display/DisplayRoutine.h"

namespace display_routine {

static const size_t MAX_CHAR_WIDTH = 6;

static const uint8_t char_data[6][472] = {
{ 1, 0, 1, 0, 1, 0, 0, 0, 0, 0, 0, 0, 0,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 0, 0 },
{ 1, 0, 1, 0, 1, 0, 0, 1, 0, 1, 0, 0, 0,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 0, 0 },
{ 1, 0, 0, 0, 0, 0, 1, 1, 1, 1, 1, 0, 1,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 0, 1 },
{ 1, 0, 0, 0, 0, 0, 0, 1, 0, 1, 0, 0, 0,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 1, 0 },
{ 0, 0, 0, 0, 0, 0, 1, 1, 1, 1, 1, 0, 0,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 0, 0 },
{ 1, 0, 0, 0, 0, 0, 0, 1, 0, 1, 0, 0, 0,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 0, 0 }
};

static const unsigned int ofs[] = {0,2,6,12,18,24,30,32,35,38,44,50,53,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467,472};

int writeChar(display::Display& display, int col, uint32_t color, char c) {
  if (c == ' ') {
    return 3;
  }
  unsigned int charDefOfs = ofs[c - '!'];
  unsigned int charDefSize = ofs[c - '!' + 1] - charDefOfs;
  for (uint8_t row = 0; row < 6; row++) {
    for (unsigned int charCol = 0; charCol < charDefSize; charCol++) {
      int ledCol = charCol + col;
      if (ledCol >= 0 && ledCol < display.width()) {
        if (char_data[row][charCol + charDefOfs]) {
          display(row + 1, ledCol) = color;
        }
      }
    }
  }
  return charDefSize;
}

int writeString(display::Display& display, int col, uint32_t color, const String& msg) {
  int charStart = col;
  for (const char* c = msg.begin(); c != msg.end(); c++) {
    int charSize = writeChar(display, charStart, color, *c);
    charStart += charSize;
  }
  return charStart;
}

Ticker::Ticker(display::Display& display): 
DisplayRoutine(display, {"", 0x0, 0x0, 30, display::Mode::TICKER, false, 64}) {
  col = display.width() - 1;
}

void Ticker::init() {
  display.clear();
  col = display.width() - 1;
}

void sanitize(String& msg) {
  unsigned int i = 0;
  while (i < msg.length()) {
    if (msg[i] >= ' ' && msg[i] <= '~') {
      i++;
    } else {
      msg.remove(i, 1);
    }
  }
}

void Ticker::step(const display::DisplayConfig& config) {
  String configmsg = config.message;
  sanitize(configmsg);
  if (msgStr != configmsg) {
    msgStr = configmsg;
    col = display.width() - 1;
    display.clear();
  }
  writeString(display, col, config.bkgColor, msgStr);
  int minColVal = -((int)msgStr.length() * MAX_CHAR_WIDTH);
  col = (col < minColVal) ? display.width() - 1 : col - 1;
  writeString(display, col, config.textColor, msgStr);
}

}