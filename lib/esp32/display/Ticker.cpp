#include <Arduino.h>
#include "DisplayRoutine.h"

namespace DisplayRoutine {

#define MAX_CHAR_WIDTH      6

static const uint8_t char_data[6][472] = {
{ 1, 0, 1, 0, 1, 0, 0, 0, 0, 0, 0, 0, 0,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 0, 0 },
{ 1, 0, 1, 0, 1, 0, 0, 1, 0, 1, 0, 0, 0,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 0, 0 },
{ 1, 0, 0, 0, 0, 0, 1, 1, 1, 1, 1, 0, 1,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 0, 1 },
{ 1, 0, 0, 0, 0, 0, 0, 1, 0, 1, 0, 0, 0,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 1, 0 },
{ 0, 0, 0, 0, 0, 0, 1, 1, 1, 1, 1, 0, 0,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 0, 0 },
{ 1, 0, 0, 0, 0, 0, 0, 1, 0, 1, 0, 0, 0,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 0, 0 }
};

static const unsigned int ofs[] = {0,2,6,12,18,24,30,32,35,38,44,50,53,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467,472};

int writeChar(Display::Display& display, int col, uint32_t color, char c) {
  if (c == ' ') {
    return 3;
  }
  unsigned int charDefOfs = ofs[c - '!'];
  unsigned int charDefSize = ofs[c - '!' + 1] - charDefOfs;
  for (uint8_t row = 0; row < 6; row++) {
    for (unsigned int charCol = 0; charCol < charDefSize; charCol++) {
      int ledCol = charCol + col;
      if (ledCol >= 0 && ledCol < display.width()) {
        if (char_data[row][charCol + charDefOfs]) {
          display.setPixel(row + 1, ledCol, color);
        }
      }
    }
  }
  return charDefSize;
}

int writeString(Display::Display& display, int col, uint32_t color, const String& msg) {
  int charStart = col;
  for (const char* c = msg.begin(); c != msg.end(); c++) {
    int charSize = writeChar(display, charStart, color, *c);
    charStart += charSize;
  }
  return charStart;
}

Ticker::Ticker(Display::Display& display): DisplayRoutine(display) {
  col = display.width() - 1;
}

void Ticker::init() {

}

void Ticker::step(const DisplayConfigServer::DisplayConfig& config) {
    if (msgStr != config.message) {
        msgStr = config.message;
        col = display.width() - 1;
        display.clear();
    }
    writeString(display, col, config.bkgColor, msgStr);
    int minColVal = -((int)msgStr.length() * MAX_CHAR_WIDTH);
    col = (col < minColVal) ? display.width() - 1 : col - 1;
    writeString(display, col, config.textColor, msgStr);
}

}